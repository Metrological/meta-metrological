## conf/layer.conf
```bitbake
BBPATH .= ":${LAYERDIR}"

BBFILES += "\
            ${LAYERDIR}/recipes-*/*/*.bb \
            ${LAYERDIR}/recipes-*/*/*.bbappend \
           "

BBFILE_COLLECTIONS += "wpe-layer"
BBFILE_PATTERN_wpe-layer := "^${LAYERDIR}/"
BBFILE_PRIORITY_wpe-layer = "20"

LAYERSERIES_COMPAT_wpe-layer = "sumo thud warrior zeus dunfell gatesgarth hardknott"

LAYERDEPENDS_wpe-layer = "core \
                          openembedded-layer \
                          multimedia-layer \
                          networking-layer \
                          meta-python \
                         "

BBFILES_DYNAMIC += " \
    raspberrypi:${LAYERDIR}/dynamic-layers/raspberrypi/recipes-*/*/*.bb \
    raspberrypi:${LAYERDIR}/dynamic-layers/raspberrypi/recipes-*/*/*.bbappend \
    \
    brcm:${LAYERDIR}/dynamic-layers/brcm/recipes-*/*/*.bb \
    brcm:${LAYERDIR}/dynamic-layers/brcm/recipes-*/*/*.bbappend \
"

LICENSE_PATH += "${LAYERDIR}/licenses"

# WPE needs mpg123 gstreamer plugin
LICENSE_FLAGS_WHITELIST += "commercial_mpg123"
LICENSE_FLAGS_WHITELIST += "commercial_gstreamer1.0-plugins-ugly"

# WPE on rpi needs the OpenMAX gstreamer plugin
LICENSE_FLAGS_WHITELIST += "commercial_libomxil"
LICENSE_FLAGS_WHITELIST += "commercial_gstreamer1.0-omx"
LICENSE_FLAGS_WHITELIST += "${@bb.utils.contains('MACHINE_FEATURES', 'vc4graphics', 'commercial_gstreamer1.0-libav', '', d)}"

# WPE needs gstreamer plugins that need faad2
LICENSE_FLAGS_WHITELIST += "commercial_faad2"

PREFERRED_VERSION_wpewebkit = "2.22%"
```
